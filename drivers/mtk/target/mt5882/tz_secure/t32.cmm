; ============= SETUP for TrustZone.... ===============
local &ic_family &core_numbers &tz_offset &jc_clock
&ic_family=0xc ; 0x9(CA9) or 0xc(CA12) or 0x7(CA7)
&core_numbers=2 ; 1 or 2 or 4 or 0x22
&jc_clock="5.0MHz"

if &ic_family==0x9
(
    if &core_numbers==0x1
    (
        SYSTEM.CPU CortexA9MPCore
	do "../../../tools/cmm/t32upcore.cmm"
    )
    else
    (
        SYSTEM.CPU CortexA9MPCoreSMP2
	do "../../../tools/cmm/t32mpcore.cmm"
    )
)
else
(
    if &ic_family==0x7
    (
        SYSTEM.CPU CortexA7MPCore
    )
    else if &ic_family==0xc
    (
        SYSTEM.CPU CortexA12MPCore
    )
    
    if &core_numbers==0x2
    (
        SYStem.CONFIG CoreNumber 2
        CORE.ASSIGN 1 2
        do "../../../tools/cmm/t32mpcore.cmm"
    )
    else if &core_numbers==0x22
    (
        SYStem.CONFIG CoreNumber 2
        CORE.ASSIGN 1 2
        do "../../../tools/cmm/t32mpcore_2.cmm"
    )
    else if &core_numbers==0x1
    (
        do "../../../tools/cmm/t32upcore.cmm"
    )
    else ;if &core_numbers==0x4
    (
        SYStem.CONFIG CoreNumber 4
        CORE.ASSIGN 1 2 3 4
        do "../../../tools/cmm/t32quadcore.cmm"
    )

)

SYS.JC &jc_clock

SYS.M attach

if run()
    break

&tz_offset=Data.Long(A:0xf0008010)+0x5000
d.load mt53xx_tz.axf &tz_offset /nocode

y.spath.srd .

TrOnchip.Set DABORT OFF
TrOnchip.Set PABORT OFF
TrOnchip.Set UNDEF OFF
TrOnchip.Set RESET OFF

Break.SELect.Program Onchip
Break.SELect.Read Onchip
Break.SELect.Write Onchip

d.l
end

